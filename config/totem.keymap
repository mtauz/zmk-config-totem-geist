/* source key position labels */
//#include "zmk-helpers/key-labels/38.h"
//#include "zmk-helpers/keypos_def/keypos_38keys.h"


/* map Zen's extra keys */
#define X_LH  &kp LGUI      // thumb row, left
#define X_RH  &smart_mouse  // thumb row, right

/* activate bluetooth */
#define CONFIG_WIRELESS 1

/* source the main keymap */
#include "base.keymap"